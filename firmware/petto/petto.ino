/*
  Petto device firmware (ESP32-S3 N16R8, ST7789 240x240, INMP441, MAX98357A, MPU6050, 3 buttons).
  Hardware as built: firmware/HARDWARE_HANDOFF.md. Brain calls: docs/hardware/DEVICE_PROTOCOL.md.

  Arduino IDE: board "ESP32S3 Dev Module", PSRAM "OPI PSRAM", Flash Size 16MB,
  Partition "16M Flash (3MB APP/9.9MB FATFS)", USB CDC On Boot "Disabled", upload on the UART USB-C.
  Libraries: Adafruit GFX, Adafruit ST7735 and ST7789, ArduinoJson 7, QRCode (Richard Moore).
  Serial Monitor 115200, type h for commands.

  Buttons: A (left) back / up, B (middle) menu / select, hold B to talk, C (right) pat / down.
  Motion: shake = dizzy, gentle rocking = sleepy. Both sync to the brain as care.

  Never logs chat text, transcripts or secrets (CLAUDE.md rules 3 and 4).
*/
#include <WiFi.h>
#include <WiFiClientSecure.h>
#include <HTTPClient.h>
#include <Preferences.h>
#include <ArduinoJson.h>
#include <SPI.h>
#include <Wire.h>
#include <Adafruit_GFX.h>
#include <Adafruit_ST7789.h>
#include <ESP_I2S.h>
#include "petto_qr.h"
#include <time.h>
#include <vector>
#include "board_config.h"
#include "nearling_sprites.h"
#include "nearling_costumes.h"   // Closet costumes, generated by firmware/tools/export-costumes.ts
#if __has_include("secrets.h")
#include "secrets.h"
#endif
#ifndef WIFI_SSID
#define WIFI_SSID ""
#endif
#ifndef WIFI_PASS
#define WIFI_PASS ""
#endif
#ifndef BRAIN_URL
#define BRAIN_URL "https://api.mypetto.xyz"   // live brain (web app: https://mypetto.xyz)
#endif

#define FW_VERSION "0.5.2"
#define WEB_URL "https://mypetto.xyz"   // QR codes always point here, whatever web URL the brain is set to
#define REC_MAX_SAMPLES (MIC_SAMPLE_HZ * REC_MAX_SECONDS)

// =====================================================================
// globals
// =====================================================================
Adafruit_ST7789 tft(&SPI, -1, PIN_TFT_DC, PIN_TFT_RST);
GFXcanvas16 *cv = nullptr;
I2SClass mic, spk;
Preferences prefs;
SemaphoreHandle_t mtx, spkMtx;
struct Lock {
  Lock() { xSemaphoreTake(mtx, portMAX_DELAY); }
  ~Lock() { xSemaphoreGive(mtx); }
};

uint16_t C_BG, C_INK, C_EGG, C_EGG_HI, C_SPOT, C_LEAF, C_BODY, C_CHEEK, C_RED, C_GREY, C_WHITE, C_BLACK;

// config (NVS namespace "nearling"; device-side names kept, CLAUDE.md)
String cfgSsid, cfgPass, cfgBrain, cfgWeb, hwId, devSecret, devToken, petRef;
uint32_t careCounter = 0;
int64_t inboxAfter = 0;
float volume = AMP_VOLUME_MAX;

// hardware status
bool mpuOK = false, micOK = false, spkOK = false;
uint8_t mpuAddr = 0x68;
float ax = 0, ay = 0, az = 0, axF = 0, shake = 0;
volatile int micLevel = 0;
volatile bool recording = false;
volatile size_t recLen = 0;
int16_t *recBuf = nullptr;      // PSRAM, REC_MAX_SAMPLES
uint8_t *talkBuf = nullptr;     // PSRAM, multipart body
bool logSensors = false;
bool costumesOk = false;   // costume table matches NL_CLIPS (checked at boot)

// ---- shared between the UI loop (core 1) and the net task (core 0): always under Lock ----
enum Phase : uint8_t { PH_BOOT, PH_NOWIFI, PH_HELLO, PH_PAIRING, PH_LOST, PH_PET };
enum TalkSt : uint8_t { TK_IDLE, TK_SENDING, TK_SPEAKING, TK_SHOW };
struct Pet {
  bool valid = false;
  String name, dstate = "happy", shirt;
  uint8_t stage = 0, traits[5] = {50, 50, 50, 50, 50};
  bool hatched = false, winged = false, fuelLow = false, demo = false;
  int fuel = 0, mood = 0, xp = 0;
  int8_t costume = -1;   // index into NL_COSTUME_KEYS, -1 = none
};
Phase phase = PH_BOOT;
String netNote;                         // short status line ("brain unreachable" ...)
String qrUrl, pairStatus, pairName;
int64_t pairExpiresMs = 0;
Pet pet;
TalkSt talkSt = TK_IDLE;
String replyText, replyEmotion, feedUrl;
bool replyCanned = false;
String inboxText;
bool inboxNew = false, evolvedNow = false;
bool wantScan = false;
bool wantConfirm = false, wantHello = false, wantReconnect = false, wantStateNow = false, talkReady = false;
struct CareEv { uint32_t n; char kind[8]; uint32_t atMillis; };
std::vector<CareEv> careQ;
// declared up here so the Arduino-generated prototypes can see them
enum Auth { AUTH_NONE, AUTH_SECRET, AUTH_TOKEN };
struct Resp { int code; String body; };

// =====================================================================
// small helpers
// =====================================================================
String randomChars(int n) {
  static const char *A = "abcdefghijklmnopqrstuvwxyzABCDEFGHIJKLMNOPQRSTUVWXYZ0123456789";
  String s;
  for (int i = 0; i < n; i++) s += A[esp_random() % 62];
  return s;
}
int64_t epochMs() {
  time_t t = time(nullptr);
  if (t < 1700000000) return 0;   // SNTP not synced yet
  struct timeval tv;
  gettimeofday(&tv, nullptr);
  return (int64_t)tv.tv_sec * 1000 + tv.tv_usec / 1000;
}
String urlEncodeRef(const String &r) {   // contract:token -> contract%3Atoken
  String o = r;
  o.replace(":", "%3A");
  return o;
}
// The built-in GFX font is ASCII only: map common Unicode punctuation, drop the rest.
String asciiize(const String &in) {
  String o;
  for (size_t i = 0; i < in.length();) {
    uint8_t c = in[i];
    if (c < 0x80) { o += (char)c; i++; continue; }
    int len = (c >= 0xF0) ? 4 : (c >= 0xE0) ? 3 : 2;
    if (len == 3 && i + 2 < in.length() && (uint8_t)in[i] == 0xE2 && (uint8_t)in[i + 1] == 0x80) {
      uint8_t d = in[i + 2];
      if (d == 0x98 || d == 0x99) o += '\'';
      else if (d == 0x9C || d == 0x9D) o += '"';
      else if (d == 0x93 || d == 0x94) o += '-';
      else if (d == 0xA6) o += "...";
    }
    i += len;
  }
  return o;
}
std::vector<String> wrapText(const String &t, int cols) {
  std::vector<String> lines;
  String line, word;
  auto flushWord = [&]() {
    while ((int)word.length() > cols) {   // very long word: hard split
      if (line.length()) { lines.push_back(line); line = ""; }
      lines.push_back(word.substring(0, cols));
      word = word.substring(cols);
    }
    if (!word.length()) return;
    if (line.length() + 1 + word.length() > (size_t)cols && line.length()) { lines.push_back(line); line = ""; }
    line += (line.length() ? " " : "") + word;
    word = "";
  };
  for (size_t i = 0; i < t.length(); i++) {
    char c = t[i];
    if (c == ' ' || c == '\n') { flushWord(); if (c == '\n' && line.length()) { lines.push_back(line); line = ""; } }
    else word += c;
  }
  flushWord();
  if (line.length()) lines.push_back(line);
  return lines;
}
void saveStr(const char *k, const String &v) { Lock l; prefs.putString(k, v); }

// =====================================================================
// audio
// =====================================================================
void micTask(void *) {
  static int32_t raw[256];
  float dc = 0;
  for (;;) {
    if (!micOK) { vTaskDelay(100); continue; }
    size_t n = mic.readBytes((char *)raw, sizeof(raw)) / 4;
    int32_t peak = 0;
    for (size_t i = 0; i < n; i++) {
      float s = (float)(raw[i] >> 14);
      dc = dc * 0.995f + s * 0.005f;
      int32_t v = constrain((int32_t)(s - dc), -32768, 32767);
      if (abs(v) > peak) peak = abs(v);
      size_t at = recLen;
      if (recording && at < REC_MAX_SAMPLES) { recBuf[at] = (int16_t)v; recLen = at + 1; }
    }
    int lvl = map(constrain(peak, 0, 12000), 0, 12000, 0, 100);
    micLevel = max(lvl, micLevel - 3);
  }
}
void playTone(int freq, int ms) {
  if (!spkOK) return;
  if (xSemaphoreTake(spkMtx, 0) != pdTRUE) return;   // voice is playing: skip the beep
  static int16_t buf[256];
  const int N = MIC_SAMPLE_HZ * ms / 1000;
  const float vol = 32767 * volume, step = 2 * PI * freq / MIC_SAMPLE_HZ;
  float ph = 0;
  for (int done = 0; done < N;) {
    int n = min(N - done, 256);
    for (int i = 0; i < n; i++) {
      int k = done + i;
      float env = min(1.0f, min(k / 200.0f, (N - k) / 200.0f));
      buf[i] = (int16_t)(sinf(ph) * vol * env);
      ph += step;
    }
    spk.write((uint8_t *)buf, n * 2);
    done += n;
  }
  xSemaphoreGive(spkMtx);
}
void chime() { playTone(880, 70); playTone(1320, 110); }

// =====================================================================
// MPU6050 (raw registers)
// =====================================================================
bool mpuWrite(uint8_t reg, uint8_t val) {
  Wire.beginTransmission(mpuAddr); Wire.write(reg); Wire.write(val);
  return Wire.endTransmission() == 0;
}
bool mpuInit() {
  for (uint8_t a : {0x68, 0x69}) {
    mpuAddr = a;
    Wire.beginTransmission(a); Wire.write(0x75);
    if (Wire.endTransmission(false) != 0) continue;
    if (Wire.requestFrom((int)a, 1) != 1) continue;
    Wire.read();   // WHO_AM_I: clones report 0x68/0x70/0x72/0x98, accept any
    mpuWrite(0x6B, 0x00); mpuWrite(0x1C, 0x00); mpuWrite(0x1B, 0x00);
    return true;
  }
  return false;
}
void mpuRead() {
  if (!mpuOK) return;
  Wire.beginTransmission(mpuAddr); Wire.write(0x3B);
  if (Wire.endTransmission(false) != 0) return;
  if (Wire.requestFrom((int)mpuAddr, 14) != 14) return;
  int16_t v[7];
  for (int i = 0; i < 7; i++) v[i] = (Wire.read() << 8) | Wire.read();
  ax = v[0] / 16384.0f; ay = v[1] / 16384.0f; az = v[2] / 16384.0f;
  axF = axF * 0.85f + ax * 0.15f;
  float mag = sqrtf(ax * ax + ay * ay + az * az);
  shake = shake * 0.85f + fabsf(mag - 1.0f) * 0.15f * 10.0f;
}

// =====================================================================
// care queue (UI pushes, net task flushes)
// =====================================================================
void enqueueCare(const char *kind) {
  uint32_t n;
  {
    Lock l;
    if (careQ.size() >= 64) careQ.erase(careQ.begin());
    n = ++careCounter;
    CareEv e{n, {0}, millis()};
    strncpy(e.kind, kind, sizeof(e.kind) - 1);
    careQ.push_back(e);
    prefs.putUInt("care_n", careCounter);
  }
  Serial.printf("[CARE] queued %s #%u\n", kind, (unsigned)n);
}

// =====================================================================
// networking (net task only)
// =====================================================================
WiFiClientSecure tlsClient;
WiFiClient plainClient;
String nBrain, nToken, nRef;   // net-task copies of the config

bool beginReq(HTTPClient &h, const String &path) {
  String url = nBrain + path;
  if (url.startsWith("https://")) {
    tlsClient.setInsecure();   // TODO: use the CA bundle (setCACertBundle) after the demo
    return h.begin(tlsClient, url);
  }
  return h.begin(plainClient, url);
}
void addAuth(HTTPClient &h, Auth a) {
  if (a == AUTH_SECRET) { h.addHeader("X-Device-Id", hwId); h.addHeader("X-Device-Secret", devSecret); }
  else if (a == AUTH_TOKEN && nToken.length()) h.addHeader("Authorization", "Device " + nToken);
}
Resp request(const char *method, const String &path, const String &body, Auth a, uint32_t timeoutMs = 10000) {
  Resp r{-1, ""};
  HTTPClient h;
  if (!nBrain.length() || !beginReq(h, path)) return r;
  h.setConnectTimeout(8000);
  h.setTimeout(timeoutMs);
  addAuth(h, a);
  uint32_t t0 = millis();
  if (!strcmp(method, "GET")) r.code = h.GET();
  else {
    h.addHeader("Content-Type", "application/json");
    r.code = h.sendRequest(method, (uint8_t *)body.c_str(), body.length());
  }
  if (r.code > 0) r.body = h.getString();
  int q = path.indexOf('?');
  Serial.printf("[NET] %s %s -> %d (%lu ms)\n", method, (q < 0 ? path : path.substring(0, q)).c_str(), r.code,
                (unsigned long)(millis() - t0));
  h.end();
  return r;
}
String errCode(const String &body) {
  JsonDocument d;
  if (deserializeJson(d, body)) return "";
  return d["error"]["code"] | "";
}
void setNote(const String &s) { Lock l; netNote = s; }
void setPhase(Phase p) { Lock l; phase = p; }
void forgetToken() {
  { Lock l; devToken = ""; petRef = ""; pet.valid = false; prefs.remove("token"); prefs.remove("pet_ref"); }
  nToken = ""; nRef = "";
}
// Any pet route answering 401 / 403 not_owner, or state saying unpaired: start over (protocol 3).
bool handleAuthLoss(const Resp &r) {
  if (r.code == 401 || (r.code == 403 && errCode(r.body) == "not_owner")) {
    Serial.println("[NET] device token no longer valid, pairing again");
    forgetToken();
    Lock l; wantHello = true;
    return true;
  }
  return false;
}

void doHello() {
  JsonDocument d;
  d["hw_id"] = hwId; d["device_secret"] = devSecret; d["fw_version"] = FW_VERSION;
  String b; serializeJson(d, b);
  Resp r = request("POST", "/devices/hello", b, AUTH_NONE);
  if (r.code != 200) { setNote(r.code < 0 ? "can't reach the brain" : "brain error " + String(r.code)); setPhase(PH_HELLO); return; }
  JsonDocument res;
  if (deserializeJson(res, r.body)) { setNote("bad hello reply"); return; }
  setNote("");
  if (res["bound"] | false) {
    String ref = res["pet_ref"] | "";
    if (nToken.length()) {
      { Lock l; petRef = ref; phase = PH_PET; wantStateNow = true; prefs.putString("pet_ref", ref); }
      nRef = ref;
    } else {
      setPhase(PH_LOST);   // bound, but the token was lost: the owner must unpair on the web
    }
  } else {
    forgetToken();
    String url = res["pairing"]["qr_url"] | "";
    int64_t exp = res["pairing"]["expires_at"] | (int64_t)0;
    int h = url.indexOf("/hatch");
    Lock l;
    qrUrl = url; pairExpiresMs = exp; pairStatus = "open"; pairName = "";
    if (h > 0) url = String(WEB_URL) + url.substring(h);   // keep "/hatch?t=<token>", use our domain
    cfgWeb = WEB_URL;
    phase = PH_PAIRING;
  }
}

void pollPairing() {
  Resp r = request("GET", "/devices/pairing", "", AUTH_SECRET);
  if (r.code == 404 || r.code == 410) { Lock l; wantHello = true; return; }
  if (r.code != 200) return;
  JsonDocument d;
  if (deserializeJson(d, r.body)) return;
  String st = d["status"] | "";
  String nm = d["pet_name"] | "";
  { Lock l; pairStatus = st; pairName = nm; }
  if (st == "expired" || st == "cancelled" || st == "confirmed") { Lock l; wantHello = true; }
}

void doConfirm() {
  Resp r = request("POST", "/devices/pairing/confirm", "", AUTH_SECRET);
  if (r.code != 200) { setNote("pairing failed (" + String(r.code) + ")"); Lock l; wantHello = true; return; }
  JsonDocument d;
  if (deserializeJson(d, r.body)) return;
  String tok = d["device_token"] | "", ref = d["pet_ref"] | "";
  {
    Lock l;
    devToken = tok; petRef = ref; phase = PH_PET; wantStateNow = true;
    prefs.putString("token", tok); prefs.putString("pet_ref", ref);
  }
  nToken = tok; nRef = ref;
  Serial.println("[PAIR] paired, token stored");
}

void pollState() {
  Resp r = request("GET", "/pets/" + urlEncodeRef(nRef) + "/state", "", AUTH_TOKEN);
  if (handleAuthLoss(r) || r.code != 200) return;
  JsonDocument d;
  if (deserializeJson(d, r.body)) { Serial.println("[NET] state: bad JSON"); return; }
  if (!(d["device"]["paired"] | true)) { forgetToken(); Lock l; wantHello = true; return; }
  Pet p;
  p.valid = true;
  p.name = asciiize(d["name"] | "Petto");
  p.stage = d["stage_index"] | 0;
  p.hatched = d["hatched"] | false;
  p.winged = String(d["form"] | "base") == "winged";
  JsonArray tr = d["traits"].as<JsonArray>();
  for (int i = 0; i < 5; i++) p.traits[i] = (uint8_t)constrain((int)(tr[i] | 50), 0, 100);
  p.dstate = d["display_state"] | "happy";
  p.shirt = d["equipped_shirt"].isNull() ? "" : String(d["equipped_shirt"].as<const char *>());
  const char *ck = d["equipped_costume"] | "";
  for (int i = 0; i < NL_COSTUME_COUNT; i++)
    if (!strcmp(ck, NL_COSTUME_KEYS[i])) { p.costume = i; break; }
  if (p.costume >= 0) p.shirt = "";   // the web draws a costume instead of the plain shirt
  p.fuel = d["fuel"]["left"] | 0;
  p.fuelLow = d["fuel"]["low"] | false;
  p.mood = d["care"]["mood"] | 0;
  p.xp = d["xp"] | 0;
  p.demo = d["demo_speed"] | false;
  Lock l; pet = p;
}

void pollInbox() {
  Resp r = request("GET", "/pets/" + urlEncodeRef(nRef) + "/inbox?after=" + String((long long)inboxAfter), "", AUTH_TOKEN);
  if (handleAuthLoss(r) || r.code != 200) return;
  JsonDocument d;
  if (deserializeJson(d, r.body)) return;
  JsonArray arr = d.as<JsonArray>();
  int64_t maxId = inboxAfter;
  String last;
  for (JsonObject it : arr) {
    int64_t id = it["id"] | (int64_t)0;
    if (id > maxId) maxId = id;
    String t = it["text"] | "";
    if (t.length()) last = t;
  }
  if (maxId <= inboxAfter) return;
  inboxAfter = maxId;
  { Lock l; prefs.putLong64("inbox_after", inboxAfter); if (last.length()) { inboxText = asciiize(last); inboxNew = true; } }
  request("POST", "/pets/" + urlEncodeRef(nRef) + "/inbox/ack", "{\"up_to\":" + String((long long)maxId) + "}", AUTH_TOKEN);
}

void flushCare() {
  int64_t nowMs = epochMs();
  if (!nowMs) return;   // need SNTP for "at"
  std::vector<CareEv> evs;
  { Lock l; evs = careQ; }
  if (evs.empty()) return;
  JsonDocument d;
  JsonArray arr = d["events"].to<JsonArray>();
  uint32_t nowM = millis();
  for (auto &e : evs) {
    JsonObject o = arr.add<JsonObject>();
    o["id"] = "c-" + hwId.substring(hwId.length() - 4) + "-" + String(e.n);
    o["kind"] = e.kind;
    o["at"] = nowMs - (int64_t)(nowM - e.atMillis);
  }
  String b; serializeJson(d, b);
  Resp r = request("POST", "/pets/" + urlEncodeRef(nRef) + "/care", b, AUTH_TOKEN);
  if (handleAuthLoss(r)) return;
  if (r.code == 200 || r.code == 400) {   // 400 = a bad batch; drop it rather than retry forever
    JsonDocument res;
    bool evolved = !deserializeJson(res, r.body) && (res["evolved_now"] | false);
    Lock l;
    size_t k = min(evs.size(), careQ.size());
    careQ.erase(careQ.begin(), careQ.begin() + k);
    if (evolved) evolvedNow = true;
    wantStateNow = true;
  }
}

void put16(uint8_t *p, uint16_t v) { p[0] = v; p[1] = v >> 8; }
void put32(uint8_t *p, uint32_t v) { p[0] = v; p[1] = v >> 8; p[2] = v >> 16; p[3] = v >> 24; }

// Streams a 16 kHz mono 16-bit WAV from the brain straight into the amp.
void playWav(const String &path) {
  if (!spkOK) return;
  HTTPClient h;
  if (!beginReq(h, path)) return;
  h.setTimeout(8000);
  const char *keys[] = {"Content-Type"};
  h.collectHeaders(keys, 1);
  int code = h.GET();
  Serial.printf("[NET] GET /audio -> %d\n", code);
  if (code != 200) { h.end(); return; }
  if (h.header("Content-Type").indexOf("wav") < 0) { Serial.println("[SPK] reply audio is not WAV, skipped"); h.end(); return; }
  WiFiClient *s = h.getStreamPtr();
  int remaining = h.getSize();
  uint8_t hdr[44];
  if (s->readBytes(hdr, 44) != 44) { h.end(); return; }
  if (remaining > 0) remaining -= 44;
  uint32_t rate = hdr[24] | (hdr[25] << 8) | (hdr[26] << 16) | ((uint32_t)hdr[27] << 24);
  if (rate != MIC_SAMPLE_HZ) Serial.printf("[SPK] WAV is %u Hz, expected 16000\n", (unsigned)rate);
  static int16_t buf[512];
  uint8_t *b8 = (uint8_t *)buf;
  size_t carry = 0;
  xSemaphoreTake(spkMtx, portMAX_DELAY);
  while (remaining != 0) {
    size_t want = sizeof(buf) - carry;
    if (remaining > 0 && want > (size_t)remaining) want = remaining;
    size_t n = s->readBytes(b8 + carry, want);
    if (!n) { if (!h.connected() && !s->available()) break; continue; }
    if (remaining > 0) remaining -= n;
    size_t tot = carry + n, samples = tot / 2;
    for (size_t i = 0; i < samples; i++) buf[i] = (int16_t)(buf[i] * volume);
    spk.write(b8, samples * 2);
    carry = tot & 1;
    if (carry) b8[0] = b8[samples * 2];
  }
  memset(buf, 0, sizeof(buf));
  spk.write(b8, sizeof(buf));   // trailing silence, no pop
  xSemaphoreGive(spkMtx);
  h.end();
}

void setReply(const String &text, const String &emo, bool canned, const String &feed, TalkSt st) {
  Lock l;
  replyText = asciiize(text); replyEmotion = emo; replyCanned = canned; feedUrl = feed; talkSt = st;
}

void doTalk() {
  size_t samples = recLen;
  uint32_t dataBytes = samples * 2;
  String reqId = "dev" + randomChars(20);
  const char *B = "pettoBoundary7d1b";
  String pre = String("--") + B + "\r\nContent-Disposition: form-data; name=\"request_id\"\r\n\r\n" + reqId +
               "\r\n--" + B + "\r\nContent-Disposition: form-data; name=\"voice\"\r\n\r\n1\r\n--" + B +
               "\r\nContent-Disposition: form-data; name=\"audio\"; filename=\"talk.wav\"\r\nContent-Type: audio/wav\r\n\r\n";
  String post = String("\r\n--") + B + "--\r\n";
  size_t len = 0;
  memcpy(talkBuf, pre.c_str(), pre.length()); len += pre.length();
  uint8_t *w = talkBuf + len;
  memcpy(w, "RIFF", 4); put32(w + 4, 36 + dataBytes); memcpy(w + 8, "WAVEfmt ", 8); put32(w + 16, 16);
  put16(w + 20, 1); put16(w + 22, 1); put32(w + 24, MIC_SAMPLE_HZ); put32(w + 28, MIC_SAMPLE_HZ * 2);
  put16(w + 32, 2); put16(w + 34, 16); memcpy(w + 36, "data", 4); put32(w + 40, dataBytes);
  len += 44;
  memcpy(talkBuf + len, recBuf, dataBytes); len += dataBytes;
  memcpy(talkBuf + len, post.c_str(), post.length()); len += post.length();

  int code = -1;
  String body;
  for (int attempt = 0; attempt < 2; attempt++) {   // retry once with the same request_id (never charged twice)
    HTTPClient h;
    if (!beginReq(h, "/pets/" + urlEncodeRef(nRef) + "/talk")) break;
    h.setConnectTimeout(8000);
    h.setTimeout(25000);
    addAuth(h, AUTH_TOKEN);
    h.addHeader("Content-Type", String("multipart/form-data; boundary=") + B);
    uint32_t t0 = millis();
    code = h.POST(talkBuf, len);
    if (code > 0) body = h.getString();
    Serial.printf("[NET] POST /talk (%.1f s audio) -> %d (%lu ms)\n", samples / (float)MIC_SAMPLE_HZ, code,
                  (unsigned long)(millis() - t0));
    h.end();
    if (code > 0) break;
  }
  Resp r{code, body};
  if (handleAuthLoss(r)) { setReply("", "happy", false, "", TK_IDLE); return; }
  if (code != 200) {
    String ec = errCode(body);
    if (code == 503 || ec == "brain_resting") setReply("zzz... my brain is resting. Try again soon.", "sleepy", true, "", TK_SHOW);
    else if (code == 429) setReply("Slow down, I'm still thinking!", "silly", true, "", TK_SHOW);
    else if (ec == "bad_audio") setReply("I couldn't hear that. Hold B and talk again?", "curious", true, "", TK_SHOW);
    else setReply(code < 0 ? "I can't reach my brain right now." : "Something went wrong (" + String(code) + ").", "sad", true, "", TK_SHOW);
    return;
  }
  JsonDocument d;
  if (deserializeJson(d, body)) { setReply("I got confused. Try again?", "sad", true, "", TK_SHOW); return; }
  String status = d["status"] | "done";
  String audio = d["audio_url"].isNull() ? "" : String(d["audio_url"].as<const char *>());
  String feed = d["feed_url"].isNull() ? "" : String(d["feed_url"].as<const char *>());
  int left = d["fuel"]["left"] | -1;
  bool canned = status != "done";
  setReply(d["reply"] | "", d["emotion"] | "happy", canned, feed, audio.length() ? TK_SPEAKING : TK_SHOW);
  Serial.printf("[TALK] status %s, fuel left %d, voice %s\n", status.c_str(), left, audio.length() ? "yes" : "no");
  if (audio.length()) playWav(audio);
  Lock l;
  if (talkSt == TK_SPEAKING) talkSt = TK_SHOW;
  wantStateNow = true;
}

// Lists the networks the board can see, so a wrong band (5 GHz) or name is obvious.
void scanWifi(const String &want) {
  Serial.println("[WIFI] scanning...");
  int n = WiFi.scanNetworks();
  bool found = false;
  for (int i = 0; i < n; i++) {
    static const char *ENC[] = {"open", "WEP", "WPA", "WPA2", "WPA/WPA2", "WPA2-Enterprise", "WPA3", "WPA2/WPA3", "WAPI", "OWE", "WPA3-Ent"};
    int e = WiFi.encryptionType(i);
    String ss = WiFi.SSID(i);
    if (ss == want) found = true;
    Serial.printf("  %-32s %4d dBm  ch %2d  %s%s\n", ss.c_str(), WiFi.RSSI(i), WiFi.channel(i),
                  e >= 0 && e < 11 ? ENC[e] : "?", ss == want ? "   <- yours" : "");
  }
  if (n <= 0) Serial.println("  no networks found (antenna / power?)");
  else if (!found) Serial.printf("[WIFI] '%s' is NOT visible: hotspot off, 5 GHz only, or name typed differently\n", want.c_str());
  WiFi.scanDelete();
}

void netTask(void *) {
  uint32_t lastPair = 0, lastState = 0, lastInbox = 0, lastCare = 0, lastHello = 0, wifiStart = 0;
  bool wasUp = false, timeSet = false;
  for (;;) {
    {
      Lock l;
      nBrain = cfgBrain; nToken = devToken; nRef = petRef;
    }
    bool reconnect;
    { Lock l; reconnect = wantReconnect; wantReconnect = false; }
    if (reconnect) { WiFi.disconnect(); wasUp = false; wifiStart = 0; }
    bool scan;
    { Lock l; scan = wantScan; wantScan = false; }
    if (scan) { String ss; { Lock l; ss = cfgSsid; } if (!wasUp) WiFi.disconnect(); scanWifi(ss); wifiStart = 0; }

    if (WiFi.status() != WL_CONNECTED) {
      if (wasUp) Serial.println("[WIFI] lost");
      wasUp = false;
      String ssid, pass;
      { Lock l; ssid = cfgSsid; pass = cfgPass; }
      if (!ssid.length()) { setPhase(PH_NOWIFI); setNote("no Wi-Fi set: serial  w ssid,pass"); vTaskDelay(500); continue; }
      if (!wifiStart || millis() - wifiStart > 15000) {
        Serial.printf("[WIFI] connecting to %s\n", ssid.c_str());
        WiFi.disconnect();
        WiFi.begin(ssid.c_str(), pass.c_str());
        static bool scannedOnce = false;
        if (wifiStart) {
          setPhase(PH_NOWIFI); setNote("can't join " + ssid);
          if (!scannedOnce) { scannedOnce = true; scanWifi(ssid); }
        }
        wifiStart = millis();
      }
      vTaskDelay(200);
      continue;
    }
    if (!wasUp) {
      wasUp = true; wifiStart = 0;
      Serial.printf("[WIFI] up, IP %s, RSSI %d\n", WiFi.localIP().toString().c_str(), WiFi.RSSI());
      if (!timeSet) { configTime(0, 0, "pool.ntp.org", "time.google.com"); timeSet = true; }
      setNote("");
      Lock l; wantHello = true;
    }
    if (!nBrain.length()) { setPhase(PH_HELLO); setNote("no brain URL: serial  u https://..."); vTaskDelay(500); continue; }

    bool hello, confirm, talk, stateNow;
    Phase ph;
    {
      Lock l;
      hello = wantHello; confirm = wantConfirm; talk = talkReady; stateNow = wantStateNow; ph = phase;
    }
    uint32_t now = millis();
    if (hello || ph == PH_BOOT || ph == PH_NOWIFI || ((ph == PH_HELLO || ph == PH_LOST) && now - lastHello > 10000)) {
      { Lock l; wantHello = false; }
      lastHello = now;
      if (ph == PH_BOOT || ph == PH_NOWIFI) setPhase(PH_HELLO);
      doHello();
      continue;
    }
    if (ph == PH_PAIRING) {
      if (confirm) { { Lock l; wantConfirm = false; } doConfirm(); continue; }
      if (now - lastPair > 2000) { lastPair = now; pollPairing(); }
    } else if (ph == PH_PET && nRef.length()) {
      if (talk) { { Lock l; talkReady = false; } doTalk(); continue; }
      if (stateNow || now - lastState > 20000) { { Lock l; wantStateNow = false; } lastState = now; pollState(); continue; }
      if (now - lastInbox > 20000 && now - lastState > 5000) { lastInbox = now; pollInbox(); continue; }
      bool haveCare;
      { Lock l; haveCare = !careQ.empty(); }
      if (haveCare && now - lastCare > 30000) { lastCare = now; flushCare(); continue; }
    }
    vTaskDelay(50);
  }
}

// =====================================================================
// buttons
// =====================================================================
struct Btn {
  uint8_t pin;
  bool raw = false, down = false, held = false, consumed = false;
  uint32_t changedAt = 0, downAt = 0;
  bool pressed = false, released = false, holdStart = false, shortPress = false;
  void update() {
    pressed = released = holdStart = shortPress = false;
    bool r = !digitalRead(pin);
    uint32_t now = millis();
    if (r != raw) { raw = r; changedAt = now; }
    if (now - changedAt >= BTN_DEBOUNCE_MS && raw != down) {
      down = raw;
      if (down) { pressed = true; downAt = now; held = false; consumed = false; }
      else { released = true; if (!held && !consumed) shortPress = true; }
    }
    if (down && !held && now - downAt >= BTN_HOLD_MS) { held = true; holdStart = true; }
  }
};
Btn bA{PIN_BTN_A}, bB{PIN_BTN_B}, bC{PIN_BTN_C};

// =====================================================================
// drawing
// =====================================================================
const char *SPROUT[9] = {"..LL..LL..", "...LLLL...", "....oo....", "..oooooo..", ".oggggggo.",
                         ".ogeggego.", ".ocggggco.", ".oggggggo.", "..oooooo.."};
void drawSprout(Adafruit_GFX &g, int x, int y, int s) {
  for (int r = 0; r < 9; r++)
    for (int c = 0; SPROUT[r][c]; c++) {
      uint16_t col;
      switch (SPROUT[r][c]) {
        case 'L': col = C_LEAF; break;
        case 'o': case 'e': col = C_INK; break;
        case 'g': col = C_BODY; break;
        case 'c': col = C_CHEEK; break;
        default: continue;
      }
      g.fillRect(x + c * s, y + r * s, s, s, col);
    }
}
void drawEgg(Adafruit_GFX &g, int x, int y, int s, float lean) {
  const int W = 16, H = 20;
  auto inside = [&](int i, int j) -> bool {
    if (i < 0 || j < 0 || i >= W || j >= H) return false;
    float v = (j + 0.5f) / H * 2.f - 1.f;
    float halfw = 0.5f * sqrtf(fmaxf(0, 1 - v * v)) * (1.0f + 0.18f * v) * 1.02f;
    float u = (i + 0.5f) / W - 0.5f - lean * (1 - v) * 0.05f;
    return fabsf(u) < halfw;
  };
  const uint8_t spots[][2] = {{5, 6}, {10, 9}, {6, 13}, {11, 15}, {8, 4}};
  for (int j = 0; j < H; j++)
    for (int i = 0; i < W; i++) {
      if (!inside(i, j)) continue;
      bool edge = !inside(i - 1, j) || !inside(i + 1, j) || !inside(i, j - 1) || !inside(i, j + 1);
      uint16_t col = edge ? C_INK : C_EGG;
      if (!edge && i >= 3 && i <= 5 && j >= 3 && j <= 6 && (i + j) % 2 == 0) col = C_EGG_HI;
      for (auto &sp : spots) if (!edge && sp[0] == i && sp[1] == j) col = C_SPOT;
      g.fillRect(x + i * s, y + j * s, s, s, col);
    }
}
void drawTitle(Adafruit_GFX &g, int x, int y, int size) {
  g.setTextSize(size); g.setTextColor(C_INK); g.setCursor(x, y); g.print("Petto");
  int cw = 6 * size;
  g.fillRect(x + 3 * cw + 2 * size, y + 2 * size, size, size, C_SPOT);
}
void textCenter(Adafruit_GFX &g, const String &s, int y, int size, uint16_t col) {
  g.setTextSize(size); g.setTextColor(col);
  int w = s.length() * 6 * size;
  g.setCursor(max(6, (TFT_W - w) / 2), y); g.print(s);
}
void hintBar(Adafruit_GFX &g, const String &s) {
  g.fillRect(0, 226, TFT_W, 14, C_INK);
  textCenter(g, s, 229, 1, C_EGG);
}

// QR (ricmoo QRCode), version chosen by byte capacity at ECC_LOW
QRCode qr;
uint8_t qrBuf[512];
String qrText;
bool qrOk = false;
void drawQR(Adafruit_GFX &g, const String &text, int cx, int cy, int maxPx) {
  static const uint16_t cap[] = {0, 17, 32, 53, 78, 106, 134, 154, 192, 230, 271};
  if (text != qrText) {
    qrText = text; qrOk = false;
    for (int v = 1; v <= 10; v++)
      if (text.length() <= cap[v]) { qrOk = qrcode_initText(&qr, qrBuf, v, ECC_LOW, text.c_str()) == 0; break; }
  }
  if (!qrOk) { textCenter(g, "link too long for QR", cy, 1, C_RED); return; }
  int n = qr.size, s = max(1, maxPx / (n + 4)), full = (n + 4) * s;
  int x0 = cx - full / 2, y0 = cy - full / 2;
  g.fillRect(x0, y0, full, full, C_WHITE);
  for (int y = 0; y < n; y++)
    for (int x = 0; x < n; x++)
      if (qrcode_getModule(&qr, x, y)) g.fillRect(x0 + (x + 2) * s, y0 + (y + 2) * s, s, s, C_BLACK);
}

// ---- pet sprites ----
const nl_clip_t *onceClip = nullptr;
uint32_t onceStart = 0;
String loopKey;
uint32_t loopStart = 0;

const nl_clip_t *pickClip(const char *name, const Pet &p) {
  bool egg = !p.hatched || p.stage == 0;
  uint8_t stage = egg ? 0 : p.stage;
  if (egg && strncmp(name, "egg_", 4) != 0) name = "egg_idle";
  uint8_t pers = nl_personality(p.traits);
  const nl_clip_t *c = nl_find_clip(name, stage, p.winged ? 1 : 0, pers);
  if (!c) c = nl_find_clip(egg ? "egg_idle" : "idle", stage, p.winged ? 1 : 0, pers);
  return c;
}
void playOnce(const char *name, const Pet &p) {
  const nl_clip_t *c = pickClip(name, p);
  if (c) { onceClip = c; onceStart = millis(); }
}
// One 32x32 4 bpp layer, scaled by s; colour indices above maxIdx are skipped.
void blitLayer(const uint8_t *f, const uint16_t *pal, uint8_t maxIdx, int x0, int y0, int s) {
  uint16_t *fb = cv->getBuffer();
  for (int y = 0; y < NL_SPRITE_SIZE; y++)
    for (int x = 0; x < NL_SPRITE_SIZE; x++) {
      uint8_t b = f[(y * NL_SPRITE_SIZE + x) >> 1];
      uint8_t i = (x & 1) ? (b & 0x0F) : (b >> 4);
      if (!i || i > maxIdx) continue;
      uint16_t col = pal[i];
      for (int dy = 0; dy < s; dy++) {
        int py = y0 + y * s + dy;
        if (py < 0 || py >= TFT_H) continue;
        for (int dx = 0; dx < s; dx++) {
          int px = x0 + x * s + dx;
          if (px >= 0 && px < TFT_W) fb[py * TFT_W + px] = col;
        }
      }
    }
}
// Same order as the web (toRgba): costume back, pet, shirt, costume front. Back drawn first and
// covered by the pet and shirt = "back only where the pet is clear".
void drawClipFrame(const nl_clip_t *c, int idx, const Pet &p, int x0, int y0, int s) {
  if (!c || !cv) return;
  uint16_t pal[16], shirtPal[4];
  nl_build_palette(p.traits, c->grey, pal);
  uint16_t back = NL_COSTUME_NONE, front = NL_COSTUME_NONE;
  int ci = c - NL_CLIPS;
  if (costumesOk && p.costume >= 0 && NL_COSTUME_CLIP_OFS[ci] != NL_COSTUME_NONE) {
    const uint16_t *r = NL_COSTUME_REF + ((uint32_t)p.costume * NL_COSTUME_FRAME_REFS + NL_COSTUME_CLIP_OFS[ci] + idx) * 2;
    back = r[0]; front = r[1];
  }
  if (back != NL_COSTUME_NONE) blitLayer(nl_costume_layer(back), NL_COSTUME_PALETTE, 15, x0, y0, s);
  blitLayer(nl_frame(c->frames[idx]), pal, 15, x0, y0, s);
  if (c->shirt && p.shirt.length()) {
    nl_build_shirt_palette(p.shirt.c_str(), c->grey, shirtPal);
    blitLayer(nl_frame(c->shirt[idx]), shirtPal, 3, x0, y0, s);
  }
  if (front != NL_COSTUME_NONE) blitLayer(nl_costume_layer(front), NL_COSTUME_PALETTE, 15, x0, y0, s);
}
// Draws the current clip: one-shot (pat, eat, evolve...) if running, else the given loop.
void drawPetSprite(const Pet &p, const char *loopName, int x0, int y0, int s) {
  uint32_t now = millis();
  if (onceClip) {
    int idx = (now - onceStart) * onceClip->fps / 1000;
    if (idx < onceClip->frame_count) { drawClipFrame(onceClip, idx, p, x0, y0, s); return; }
    onceClip = nullptr;
  }
  const nl_clip_t *c = pickClip(loopName, p);
  if (!c) return;
  if (loopKey != c->name) { loopKey = c->name; loopStart = now; }
  int idx = ((now - loopStart) * c->fps / 1000) % c->frame_count;
  drawClipFrame(c, idx, p, x0, y0, s);
}
const char *stateClip(const String &ds) {
  if (ds == "sad") return "sad";
  if (ds == "hungry") return "hungry";
  if (ds == "sleepy") return "sleep";
  if (ds == "starving") return "starving";
  if (ds == "dormant") return "dormant";
  return "idle";
}
const char *emotionClip(const String &e) {
  if (e == "excited") return "celebrate";
  if (e == "sleepy") return "sleep";
  if (e == "sad") return "sad";
  if (e == "hungry") return "hungry";
  if (e == "curious") return "think";
  if (e == "silly") return "dizzy";
  return "idle";
}

// hearts after a pat
struct Heart { int16_t x; uint32_t t0; };
Heart hearts[6];
void spawnHearts() {
  for (int i = 0; i < 6; i++) hearts[i] = {(int16_t)(60 + esp_random() % 120), millis() + i * 120};
}
void drawHearts(Adafruit_GFX &g) {
  static const char *H[4] = {".x.x.", "xxxxx", ".xxx.", "..x.."};
  uint32_t now = millis();
  for (auto &h : hearts) {
    if (!h.t0 || now < h.t0) continue;
    uint32_t a = now - h.t0;
    if (a > 1200) { h.t0 = 0; continue; }
    int y = 170 - a / 8;
    for (int r = 0; r < 4; r++)
      for (int c = 0; c < 5; c++)
        if (H[r][c] == 'x') g.fillRect(h.x + c * 3, y + r * 3, 3, 3, C_RED);
  }
}

// =====================================================================
// UI state (UI thread only)
// =====================================================================
enum Mode : uint8_t { M_PET, M_MENU, M_STATS, M_FEEDQR, M_DEVICE };
Mode mode = M_PET;
int menuSel = 0;
const char *MENU[] = {"Stats", "Sleep", "Feed me (QR)", "Device", "Back"};
const int MENU_N = 5;
bool pairDeclined = false;
String bubble;                  // reply or inbox text being shown
std::vector<String> bubbleLines;
uint32_t bubbleStart = 0, bubbleUntil = 0;
String emotionNow;
uint32_t emotionUntil = 0, sleepUntil = 0, lastShake = 0, lastRock = 0, recStart = 0;
TalkSt lastTalkSt = TK_IDLE;
bool lastHatched = false, havePetBefore = false;
// rock detection: sign changes of the filtered x tilt
int rockSign = 0;
uint32_t rockTimes[4] = {0};

void showBubble(const String &t, uint32_t ms) {
  bubble = t; bubbleLines = wrapText(t, 36); bubbleStart = millis(); bubbleUntil = millis() + ms;
}
void drawBubble(Adafruit_GFX &g, int top) {
  int h = 222 - top;
  g.fillRoundRect(6, top, 228, h, 8, C_WHITE);
  g.drawRoundRect(6, top, 228, h, 8, C_INK);
  int rows = (h - 8) / 10, n = bubbleLines.size(), off = 0;
  if (n > rows) off = min(n - rows, (int)((millis() - bubbleStart) / 2500));
  g.setTextSize(1); g.setTextColor(C_INK);
  for (int i = 0; i < rows && off + i < n; i++) { g.setCursor(12, top + 6 + i * 10); g.print(bubbleLines[off + i]); }
}
String feedLink(const Pet &, const String &fromTalk, const String &web, const String &ref) {
  if (fromTalk.length()) return fromTalk.startsWith("http") ? fromTalk : web + fromTalk;
  if (!web.length() || !ref.length()) return "";
  return web + "/feed/" + urlEncodeRef(ref);
}

void renderFrame() {
  if (!cv) return;
  Adafruit_GFX &g = *cv;
  // snapshot shared state
  Phase ph; String note, qurl, pstat, pname, reply, emo, feed, web, ref, inbox; int64_t pexp; Pet p; TalkSt ts; bool canned;
  {
    Lock l;
    ph = phase; note = netNote; qurl = qrUrl; pstat = pairStatus; pname = pairName; pexp = pairExpiresMs; p = pet;
    ts = talkSt; reply = replyText; emo = replyEmotion; canned = replyCanned; feed = feedUrl; web = cfgWeb; ref = petRef;
  }
  uint32_t now = millis();
  g.fillScreen(C_BG);

  if (ph == PH_BOOT || ph == PH_NOWIFI || ph == PH_HELLO || ph == PH_LOST) {
    drawSprout(g, 30, 36 + (int)(sinf(now / 300.0f) * 2), 3);
    drawSprout(g, 128, 40 + (int)(sinf(now / 300.0f + 2) * 2), 3);
    drawTitle(g, 31, 60, 6);
    drawEgg(g, 96, 112, 3, sinf(now / 600.0f));
    String line = ph == PH_LOST ? "Unpair this device on the web" : ph == PH_HELLO ? "talking to the brain..." : "connecting Wi-Fi...";
    textCenter(g, line, 188, 1, C_INK);
    if (note.length()) textCenter(g, note, 202, 1, C_RED);
    hintBar(g, "Petto " FW_VERSION);
  } else if (ph == PH_PAIRING) {
    if (pstat == "awaiting_confirm" && !pairDeclined) {
      drawEgg(g, 80, 30, 5, sinf(now / 200.0f) * 1.5f);
      textCenter(g, "Pair " + pname + "?", 150, 2, C_INK);
      textCenter(g, "Press B to hatch", 180, 1, C_INK);
      hintBar(g, "B yes      A no");
    } else {
      drawQR(g, qurl, 120, 100, 184);
      String sub = pstat == "claimed" ? "almost there..." : "Scan to hatch";
      int64_t left = pexp && epochMs() ? (pexp - epochMs()) / 1000 : -1;
      if (left >= 0) sub += "  " + String((int)(left / 60)) + ":" + (left % 60 < 10 ? "0" : "") + String((int)(left % 60));
      textCenter(g, sub, 200, 1, C_INK);
      if (note.length()) textCenter(g, note, 212, 1, C_RED);
      hintBar(g, pairDeclined ? "declined: scan again on the web" : "scan with your phone");
    }
  } else if (!p.valid) {
    drawEgg(g, 80, 50, 5, 0);
    textCenter(g, "waking up...", 170, 1, C_INK);
    if (note.length()) textCenter(g, note, 186, 1, C_RED);
    hintBar(g, "Petto " FW_VERSION);
  } else if (mode == M_MENU) {
    textCenter(g, "Menu", 12, 2, C_INK);
    for (int i = 0; i < MENU_N; i++) {
      int y = 44 + i * 34;
      if (i == menuSel) g.fillRoundRect(20, y - 6, 200, 26, 6, C_SPOT);
      textCenter(g, MENU[i], y, 2, i == menuSel ? C_WHITE : C_INK);
    }
    hintBar(g, "A up    C down    B select");
  } else if (mode == M_STATS) {
    static const char *STG[] = {"Egg", "Baby", "Teen", "Adult"};
    textCenter(g, p.name, 10, 2, C_INK);
    drawPetSprite(p, stateClip(p.dstate), 88, 34, 2);
    g.setTextSize(1); g.setTextColor(C_INK);
    int y = 112;
    auto row = [&](const String &k, const String &v) { g.setCursor(24, y); g.print(k); g.setCursor(120, y); g.print(v); y += 14; };
    row("stage", String(STG[min((int)p.stage, 3)]) + (p.winged ? " (winged)" : ""));
    row("xp", String(p.xp));
    row("fuel", String(p.fuel) + " chats" + (p.fuelLow ? " (low)" : ""));
    row("mood", String(p.mood) + " / 100");
    row("feeling", p.dstate);
    if (p.demo) row("speed", "demo speed");
    hintBar(g, "A back");
  } else if (mode == M_FEEDQR) {
    String link = feedLink(p, feed, web, ref);
    textCenter(g, "Feed " + p.name, 10, 2, C_INK);
    if (link.length()) drawQR(g, link, 120, 120, 170);
    else textCenter(g, "Open the Petto web app to feed me", 110, 1, C_INK);
    textCenter(g, "scan to give fuel", 210, 1, C_INK);
    hintBar(g, "A back");
  } else if (mode == M_DEVICE) {
    textCenter(g, "Device", 10, 2, C_INK);
    g.setTextSize(1); g.setTextColor(C_INK);
    int y = 44;
    auto row = [&](const String &k, const String &v) { g.setCursor(12, y); g.print(k); g.setCursor(70, y); g.print(v.substring(0, 27)); y += 14; };
    row("id", hwId);
    row("wifi", WiFi.isConnected() ? WiFi.SSID() + " " + String(WiFi.RSSI()) + "dBm" : String("offline"));
    row("ip", WiFi.localIP().toString());
    String br; { Lock l; br = cfgBrain; }
    row("brain", br.length() > 8 ? br.substring(8) : br);
    row("pet", ref);
    row("fw", FW_VERSION);
    row("mic", micOK ? "ok" : "ERR");
    row("speaker", spkOK ? "ok" : "ERR");
    row("motion", mpuOK ? "ok" : "ERR");
    row("psram", String(ESP.getPsramSize() / 1024) + " KB");
    hintBar(g, "A back");
  } else {
    // ---- pet screen ----
    bool talking = recording || ts == TK_SENDING || ts == TK_SPEAKING || ts == TK_SHOW || now < bubbleUntil;
    // header: name + fuel
    g.setTextSize(2); g.setTextColor(C_INK); g.setCursor(10, 8); g.print(p.name.substring(0, 10));
    int fw = 70, fx = 160, fill = min(p.fuel, 20) * (fw - 2) / 20;
    g.drawRect(fx, 10, fw, 10, C_INK);
    g.fillRect(fx + 1, 11, fill, 8, p.fuel == 0 ? C_RED : p.fuelLow ? C_LEAF : C_SPOT);
    g.setTextSize(1); g.setCursor(fx, 24); g.print(String(p.fuel) + " fuel");
    if (p.demo) { g.setCursor(10, 26); g.setTextColor(C_SPOT); g.print("demo speed"); }

    const char *loopName = stateClip(p.dstate);
    if (now < sleepUntil) loopName = "sleep";
    if (now < emotionUntil) loopName = emotionClip(emotionNow);
    if (recording) loopName = "listen";
    else if (ts == TK_SENDING) loopName = "think";
    else if (ts == TK_SPEAKING) loopName = "talk";

    if (!talking) {
      drawPetSprite(p, loopName, 40, 40, 5);   // 160 px
      drawHearts(g);
      if (p.fuel == 0) textCenter(g, "out of fuel: feed me!", 210, 1, C_RED);
      else if (p.fuelLow) textCenter(g, "fuel is low", 210, 1, C_INK);
      hintBar(g, "B menu   hold B talk   C pat");
    } else {
      drawPetSprite(p, loopName, 72, 32, 3);   // 96 px, bubble below
      if (recording) {
        g.fillRoundRect(50, 140, 140, 24, 12, C_RED);
        textCenter(g, "listening...", 148, 1, C_WHITE);
        g.drawRect(40, 176, 160, 10, C_INK);
        g.fillRect(41, 177, micLevel * 158 / 100, 8, C_SPOT);
        float secs = (now - recStart) / 1000.0f;
        textCenter(g, String(secs, 1) + " / " + String(REC_MAX_SECONDS) + " s", 194, 1, C_INK);
        hintBar(g, "release B to send");
      } else if (ts == TK_SENDING) {
        g.fillRoundRect(6, 134, 228, 50, 8, C_WHITE);
        g.drawRoundRect(6, 134, 228, 50, 8, C_INK);
        String dots = "thinking";
        for (int i = 0; i < (int)(now / 400) % 4; i++) dots += ".";
        textCenter(g, dots, 154, 2, C_INK);
        hintBar(g, "private AI on NEAR, 1 fuel");
      } else {
        drawBubble(g, 134);
        hintBar(g, feed.length() || (canned && p.fuel == 0) ? "A close    C feed me" : "A close");
      }
    }
  }
  tft.drawRGBBitmap(0, 0, cv->getBuffer(), TFT_W, TFT_H);
}

// =====================================================================
// UI logic
// =====================================================================
void stopRecording(bool send) {
  recording = false;
  uint32_t ms = recLen * 1000 / MIC_SAMPLE_HZ;
  if (!send || ms < REC_MIN_MS) { Serial.println("[MIC] too short, ignored"); return; }
  Serial.printf("[MIC] recorded %.1f s\n", ms / 1000.0f);
  Lock l;
  talkReady = true; talkSt = TK_SENDING;
}

void uiPet(const Pet &p, TalkSt ts) {
  uint32_t now = millis();
  bool busy = recording || ts == TK_SENDING || ts == TK_SPEAKING;
  // B: short = menu, hold = talk
  if (bB.holdStart && !busy && ts != TK_SHOW && now >= bubbleUntil) {
    recLen = 0; recording = true; recStart = now;
    Serial.println("[MIC] listening");
  }
  if (recording && recLen >= REC_MAX_SAMPLES) { bB.consumed = true; stopRecording(true); }
  if (bB.released && recording) stopRecording(true);
  if (bB.shortPress && !busy && ts != TK_SHOW && now >= bubbleUntil) { mode = M_MENU; menuSel = 0; return; }

  if (ts == TK_SHOW || now < bubbleUntil) {
    if (bA.shortPress) { Lock l; if (talkSt == TK_SHOW) talkSt = TK_IDLE; bubbleUntil = 0; }
    String feed; bool canned;
    { Lock l; feed = feedUrl; canned = replyCanned; }
    if (bC.shortPress && (feed.length() || (canned && p.fuel == 0))) { Lock l; if (talkSt == TK_SHOW) talkSt = TK_IDLE; bubbleUntil = 0; mode = M_FEEDQR; }
    return;
  }
  if (busy) return;
  // C: pat
  if (bC.shortPress) {
    playOnce("pat", p); spawnHearts(); enqueueCare("pat"); playTone(1200, 60);
  }
  // motion care
  if (mpuOK) {
    if (shake > SHAKE_THRESHOLD && now - lastShake > 4000) {
      lastShake = now; playOnce("dizzy", p); enqueueCare("shake");
    }
    int sgn = axF > 0.12f ? 1 : axF < -0.12f ? -1 : 0;
    if (sgn && sgn != rockSign) {
      if (rockSign) { memmove(rockTimes, rockTimes + 1, sizeof(uint32_t) * 3); rockTimes[3] = now; }
      rockSign = sgn;
    }
    if (shake < 1.0f && rockTimes[1] && now - rockTimes[1] < 3000 && now - lastRock > 6000) {
      lastRock = now; memset(rockTimes, 0, sizeof(rockTimes));
      playOnce("rock", p); enqueueCare("rock");
    }
  }
}

void uiLoop() {
  Phase ph; Pet p; TalkSt ts; String reply, emo, inbox; bool inNew, evolved;
  {
    Lock l;
    ph = phase; p = pet; ts = talkSt; reply = replyText; emo = replyEmotion;
    inNew = inboxNew; inbox = inboxText; inboxNew = false;
    evolved = evolvedNow; evolvedNow = false;
  }
  uint32_t now = millis();
  // transitions coming from the net task
  if (ts != lastTalkSt) {
    if (ts == TK_SHOW && lastTalkSt != TK_SHOW) {
      showBubble(reply, 8000 + reply.length() * 60);
      emotionNow = emo; emotionUntil = bubbleUntil;
    }
    if (ts == TK_SPEAKING) showBubble(reply, 600000);
    if (ts == TK_IDLE) bubbleUntil = 0;
    lastTalkSt = ts;
  }
  if (ts == TK_SHOW && now > bubbleUntil) { Lock l; if (talkSt == TK_SHOW) talkSt = TK_IDLE; }
  if (inNew && ph == PH_PET && ts == TK_IDLE) { chime(); showBubble(inbox, 9000); Serial.println("[INBOX] new message shown"); }
  if (p.valid) {
    if (havePetBefore && p.hatched && !lastHatched) { Pet e = p; e.hatched = false; playOnce("egg_hatch", e); chime(); }
    lastHatched = p.hatched; havePetBefore = true;
    if (evolved) { playOnce("evolve", p); chime(); }
  }

  if (ph == PH_PAIRING) {
    if (bB.shortPress && !pairDeclined) {
      Lock l;
      if (pairStatus == "awaiting_confirm") { wantConfirm = true; }
    }
    if (bA.shortPress) pairDeclined = true;
    if (bB.shortPress && pairDeclined) pairDeclined = false;
    return;
  }
  pairDeclined = false;
  if (ph != PH_PET || !p.valid) { mode = M_PET; return; }

  switch (mode) {
    case M_PET: uiPet(p, ts); break;
    case M_MENU:
      if (bA.shortPress) menuSel = (menuSel + MENU_N - 1) % MENU_N;
      if (bC.shortPress) menuSel = (menuSel + 1) % MENU_N;
      if (bB.shortPress) {
        switch (menuSel) {
          case 0: mode = M_STATS; break;
          case 1: enqueueCare("sleep"); sleepUntil = now + 20000; mode = M_PET; break;
          case 2: { Lock l; feedUrl = ""; } mode = M_FEEDQR; break;
          case 3: mode = M_DEVICE; break;
          default: mode = M_PET;
        }
      }
      break;
    default:
      if (bA.shortPress || bB.shortPress) mode = M_PET;
  }
}

// =====================================================================
// serial commands (line based)
// =====================================================================
void help() {
  Serial.println(F("\n--- Petto commands ---"));
  Serial.println(F(" w ssid,pass   set Wi-Fi          u <url>   set brain URL"));
  Serial.println(F(" i             info               f         forget pairing (new pairing on next hello)"));
  Serial.println(F(" v 0.4         volume 0..0.6      s         sensor log on/off"));
  Serial.println(F(" b             beep               n         scan Wi-Fi networks"));
  Serial.println(F(" h             this help\n"));
}
void info() {
  Lock l;
  Serial.printf("fw %s  hw_id %s  wifi '%s' %s  IP %s\n", FW_VERSION, hwId.c_str(), cfgSsid.c_str(),
                WiFi.isConnected() ? "up" : "down", WiFi.localIP().toString().c_str());
  Serial.printf("brain %s  web %s  pet %s  token %s\n", cfgBrain.c_str(), cfgWeb.c_str(), petRef.c_str(), devToken.length() ? "stored" : "none");
  Serial.printf("mic %d spk %d mpu %d  PSRAM %u KB  heap %u KB  phase %d\n", micOK, spkOK, mpuOK,
                ESP.getPsramSize() / 1024, ESP.getFreeHeap() / 1024, phase);
}
void serialPoll() {
  static String line;
  while (Serial.available()) {
    char c = Serial.read();
    if (c == '\r') continue;
    if (c != '\n') { if (line.length() < 200) line += c; continue; }
    String cmd = line; line = ""; cmd.trim();
    if (!cmd.length()) continue;
    char k = cmd[0];
    String arg = cmd.length() > 2 ? cmd.substring(2) : "";
    arg.trim();
    if (k == 'h') help();
    else if (k == 'i') info();
    else if (k == 'b') playTone(880, 200);
    else if (k == 'n') { Lock l; wantScan = true; }
    else if (k == 's') logSensors = !logSensors;
    else if (k == 'v') { volume = constrain(arg.toFloat(), 0.0f, AMP_VOLUME_MAX); Serial.printf("volume %.2f\n", volume); }
    else if (k == 'w') {
      int comma = arg.indexOf(',');
      String ss = comma < 0 ? arg : arg.substring(0, comma), pw = comma < 0 ? "" : arg.substring(comma + 1);
      { Lock l; cfgSsid = ss; cfgPass = pw; prefs.putString("ssid", ss); prefs.putString("pass", pw); wantReconnect = true; }
      Serial.printf("Wi-Fi set to '%s' (password %u characters), reconnecting\n", ss.c_str(), (unsigned)pw.length());
    } else if (k == 'u') {
      while (arg.endsWith("/")) arg.remove(arg.length() - 1);
      { Lock l; cfgBrain = arg; prefs.putString("brain", arg); wantHello = true; }
      Serial.printf("brain URL set to %s\n", arg.c_str());
    } else if (k == 'f') {
      { Lock l; devToken = ""; petRef = ""; pet.valid = false; prefs.remove("token"); prefs.remove("pet_ref"); wantHello = true; }
      Serial.println("pairing forgotten");
    } else Serial.println("unknown command, h for help");
  }
}

// =====================================================================
void setup() {
  Serial.begin(115200);
  delay(800);
  Serial.printf("\n\n=== Petto %s ===\n", FW_VERSION);
  Serial.printf("[CHIP] %s, PSRAM %u KB\n", ESP.getChipModel(), ESP.getPsramSize() / 1024);
  if (!ESP.getPsramSize()) Serial.println(F("[WARN] PSRAM 0 KB -> Tools > PSRAM > OPI PSRAM"));
  mtx = xSemaphoreCreateMutex();
  spkMtx = xSemaphoreCreateMutex();

  pinMode(PIN_BTN_A, INPUT_PULLUP); pinMode(PIN_BTN_B, INPUT_PULLUP); pinMode(PIN_BTN_C, INPUT_PULLUP);

  // screen
  pinMode(PIN_TFT_BLK, OUTPUT); digitalWrite(PIN_TFT_BLK, HIGH);
  SPI.begin(PIN_TFT_SCLK, -1, PIN_TFT_MOSI, -1);
  tft.init(TFT_W, TFT_H, TFT_SPI_MODE);
  tft.setSPISpeed(40000000);
  tft.setRotation(TFT_ROTATION);
  C_BG = tft.color565(246, 250, 243); C_INK = tft.color565(26, 52, 36); C_EGG = tft.color565(196, 240, 204);
  C_EGG_HI = tft.color565(232, 252, 236); C_SPOT = tft.color565(88, 196, 120); C_LEAF = tft.color565(120, 214, 96);
  C_BODY = tft.color565(98, 204, 120); C_CHEEK = tft.color565(150, 230, 168); C_RED = tft.color565(220, 70, 60);
  C_GREY = tft.color565(205, 214, 205); C_WHITE = 0xFFFF; C_BLACK = 0x0000;
  tft.fillScreen(C_BG);
  cv = new GFXcanvas16(TFT_W, TFT_H);
  if (!cv->getBuffer()) { delete cv; cv = nullptr; Serial.println(F("[TFT] no frame buffer: enable OPI PSRAM")); }

  // NVS
  prefs.begin("nearling", false);
  cfgSsid = prefs.getString("ssid", WIFI_SSID);
  cfgPass = prefs.getString("pass", WIFI_PASS);
  cfgBrain = prefs.getString("brain", BRAIN_URL);
  cfgWeb = WEB_URL;
  devSecret = prefs.getString("secret", "");
  if (devSecret.length() < 16) { devSecret = randomChars(32); prefs.putString("secret", devSecret); }   // once per device, never regenerated
  devToken = prefs.getString("token", "");
  petRef = prefs.getString("pet_ref", "");
  careCounter = prefs.getUInt("care_n", 0);
  inboxAfter = prefs.getLong64("inbox_after", 0);
  char id[13];
  snprintf(id, sizeof(id), "%012llx", (unsigned long long)ESP.getEfuseMac());
  hwId = id;

  // motion
  Wire.begin(PIN_I2C_SDA, PIN_I2C_SCL, 400000);
  // costume data must come from the same sprite export as nearling_sprites.h
  costumesOk = NL_COSTUME_CLIPS == NL_CLIP_COUNT;
  for (int i = 0; costumesOk && i < NL_CLIP_COUNT; i++) costumesOk = NL_COSTUME_CLIP_FRAMES[i] == NL_CLIPS[i].frame_count;
  Serial.println(costumesOk ? "[ART] costumes ok" : "[ART] costume table out of date: re-run firmware/tools/export-costumes.ts");

  mpuOK = mpuInit();
  Serial.println(mpuOK ? "[MPU] ok" : "[MPU] NOT FOUND (SDA 1, SCL 2)");

  // audio: two separate I2S peripherals
  mic.setPins(PIN_MIC_SCK, PIN_MIC_WS, -1, PIN_MIC_SD);
  micOK = mic.begin(I2S_MODE_STD, MIC_SAMPLE_HZ, I2S_DATA_BIT_WIDTH_32BIT, I2S_SLOT_MODE_MONO, I2S_STD_SLOT_LEFT);
  spk.setPins(PIN_AMP_BCLK, PIN_AMP_LRC, PIN_AMP_DIN);
  spkOK = spk.begin(I2S_MODE_STD, MIC_SAMPLE_HZ, I2S_DATA_BIT_WIDTH_16BIT, I2S_SLOT_MODE_MONO);
  recBuf = (int16_t *)ps_malloc(REC_MAX_SAMPLES * 2);
  talkBuf = (uint8_t *)ps_malloc(REC_MAX_SAMPLES * 2 + 1024);
  if (!recBuf || !talkBuf) { micOK = false; Serial.println(F("[MIC] no PSRAM buffer, talk disabled")); }
  Serial.printf("[MIC] %s  [SPK] %s\n", micOK ? "ok" : "FAILED", spkOK ? "ok" : "FAILED");

  xTaskCreatePinnedToCore(micTask, "mic", 4096, nullptr, 3, nullptr, 1);
  WiFi.mode(WIFI_STA);
  WiFi.setAutoReconnect(true);
  WiFi.onEvent([](arduino_event_id_t e, arduino_event_info_t info) {   // say why a join failed
    if (e != ARDUINO_EVENT_WIFI_STA_DISCONNECTED) return;
    uint8_t r = info.wifi_sta_disconnected.reason;
    const char *hint = (r == 15 || r == 202 || r == 204 || r == 2) ? "  -> wrong password, or set hotspot security to WPA2"
                     : (r == 201) ? "  -> network not found: 2.4 GHz band? exact name?" : "";
    Serial.printf("[WIFI] join failed: reason %u %s%s\n", r, WiFi.disconnectReasonName((wifi_err_reason_t)r), hint);
  });
  xTaskCreatePinnedToCore(netTask, "net", 20480, nullptr, 1, nullptr, 0);

  playTone(660, 120); playTone(990, 160);
  help();
  info();
}

void loop() {
  serialPoll();
  mpuRead();
  bA.update(); bB.update(); bC.update();
  uiLoop();
  static uint32_t lastDraw = 0, lastLog = 0;
  if (millis() - lastDraw >= 40) { lastDraw = millis(); renderFrame(); }
  if (logSensors && millis() - lastLog > 300) {
    lastLog = millis();
    Serial.printf("BTN A%d B%d C%d | acc %+5.2f %+5.2f %+5.2f | shake %4.1f | mic %3d%%\n", bA.down, bB.down, bC.down,
                  ax, ay, az, shake, micLevel);
  }
  delay(2);
}
